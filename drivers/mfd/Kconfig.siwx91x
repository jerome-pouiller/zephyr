## drivers/mfd/Kconfig.siwx91x
```kconfig
# Copyright (c) 2025 Silicon Laboratories Inc.
# SPDX-License-Identifier: Apache-2.0

menuconfig MFD_SILABS_SIWX91X_NWP
	bool "Silabs SiWx91x Network Coprocessor"
	default y
	depends on DT_HAS_SILABS_SIWX91X_NWP_ENABLED || DT_HAS_SILABS_SIWX91X_NWP_SPI_ENABLED
	select HAS_SILABS_WISECONNECT
	select CMSIS_RTOS_V2
	select POLL
	select DYNAMIC_THREAD
	select THREAD_NAME
	select THREAD_STACK_INFO
	select THREAD_MONITOR
	select INIT_STACKS
	help
	  Add support for Network Coprocessor (also named NWP) presents on SiWx91x parts.

if MFD_SILABS_SIWX91X_NWP

config MFD_SILABS_SIWX91X_NWP_AHB
	bool
	default y
	depends on DT_HAS_SILABS_SIWX91X_NWP_ENABLED
	depends on SOC_FAMILY_SILABS_SIWX91X
	select CODE_DATA_RELOCATION_SRAM
	help
	  Host interface used when the NWP shares the die with the host, which is the
	  case of the SiWG917 parts. The NWP is then reachable through the internal AHB
	  bus.

config MFD_SILABS_SIWX91X_NWP_SPI
	bool
	default y
	depends on DT_HAS_SILABS_SIWX91X_NWP_SPI_ENABLED
	# using select at this point introduces a cyclic dependency
	depends on SPI
	depends on GPIO
	help
	  Host interface used when the NWP is a standalone chip, which is the case
	  of the SiWN917 parts. The NWP is then reachable over SPI from any host.

config MFD_SILABS_SIWX91X_NWP_INIT_PRIORITY
	int "SiWx91x Network Processor init priority"
	default 39 if MFD_SILABS_SIWX91X_NWP_AHB
	default KERNEL_INIT_PRIORITY_DEVICE
	help
	  Initialization priority of the SiWx91x Network Processor. NWP init must
	  have a higher priority than services that depend on it, such as Bluetooth,
	  Wi-Fi and crypto. When the NWP is accessed over a bus, it also has to be
	  initialized after that bus.

endif # MFD_SILABS_SIWX91X_NWP
```

## drivers/wifi/silabs_series3/Kconfig.silabs_series3
```kconfig
# Copyright (c) 2026 Silicon Laboratories Inc.
# SPDX-License-Identifier: Apache-2.0

config WIFI_SILABS_SERIES3
	bool "Silicon Labs Series 3 co-processor Wi-Fi driver"
	default y
	depends on DT_HAS_SILABS_SERIES3_WIFI_ENABLED
	depends on WIFI_NM_WPA_SUPPLICANT
	select NET_L2_ETHERNET
	select NET_L2_WIFI_MGMT
	select WIFI_USE_NATIVE_NETWORKING
	help
	  Wi-Fi driver for a station running on a Silicon Labs network
	  co-processor. Ethernet frames and the commands of the network
	  processor are carried by two CPC endpoints of the co-processor. The
	  Zephyr supplicant drives the association and the key exchange.

if WIFI_SILABS_SERIES3

config WIFI_SILABS_SERIES3_INIT_PRIORITY
	int "Initialization priority"
	default 87
	help
	  Must be greater than MFD_SILABS_NCP_INIT_PRIORITY and lower than
	  NET_INIT_PRIO.

config WIFI_SILABS_SERIES3_DATA_RX_COUNT
	int "Number of Ethernet frame buffers handed to CPC"
	default 4

config WIFI_SILABS_SERIES3_MGMT_RX_COUNT
	int "Number of management frame buffers handed to CPC"
	default 2

endif # WIFI_SILABS_SERIES3
```

## drivers/wifi/siwx91x/Kconfig.siwx91x
```kconfig
# Copyright (c) 2024 Silicon Laboratories Inc.
# SPDX-License-Identifier: Apache-2.0

config WIFI_SILABS_SIWX91X
	bool "Silabs SiWx91x SoC series WiFi driver"
	default y
	depends on DT_HAS_SILABS_SIWX91X_WIFI_ENABLED
	depends on NETWORKING
	select SILABS_SIWX91X_NWP
	select NET_L2_ETHERNET_RESERVE_HEADER
	select NET_L2_WIFI_MGMT
	help
	  Enable WiFi driver for the Silabs SiWx91x SoC series.

if WIFI_SILABS_SIWX91X

module = SIWX91X_WIFI
module-str = siwx91x_wifi
source "subsys/logging/Kconfig.template.log_config"

choice
        prompt "Network stack"
        default WIFI_SILABS_SIWX91X_NET_STACK_NATIVE
        help
          Choose "Native" stack if you want a better compatibility with Zephyr
          features. "Offloaded" stack may provide better resource (power and
          memory) consumption.

config WIFI_SILABS_SIWX91X_NET_STACK_NATIVE
        bool "Native"
        select WIFI_USE_NATIVE_NETWORKING
        select NET_L2_ETHERNET

endchoice

config WIFI_SILABS_SIWX91X_MFP
        bool "802.11w Management Frame Protection (MFP) support"
        default y
        help
	  Support for MFP incrase security of the WiFi infrastructures. It is required for WPA3 and
	  recommended for WPA2 networks. Howver, user may want to disable it to improve TCP
	  throughput by about 10-12% (≈1–2 Mbps).

endif
```

## dts/bindings/bluetooth/silabs,series3-hci.yaml
```yaml
# Copyright (c) 2026 Silicon Laboratories Inc.
# SPDX-License-Identifier: Apache-2.0

description: |
  Bluetooth HCI controller running on a Silicon Labs Series 3 network
  co-processor. The node is a child of the "silabs,ncp" device, the HCI
  packets (H4 framing) are carried by a dedicated CPC endpoint.

  Example:

    &ncp {
        ncp_hci: bt-hci {
            compatible = "silabs,series3-hci";
        };
    };

compatible: "silabs,series3-hci"

include: bt-hci.yaml

properties:
  bt-hci-name:
    default: "series3"
  bt-hci-bus:
    default: "virtual"
  endpoint-id:
    type: int
    default: 14
    description: |
      CPC endpoint carrying the HCI packets. Defaults to the Bluetooth RCP
      endpoint of CPC.
```

## dts/bindings/mfd/silabs,siwx91x-nwp-common.yaml
```yaml
# Copyright (c) 2025 Silicon Laboratories Inc.
# SPDX-License-Identifier: Apache-2.0

description: |
  Properties shared by all the host interfaces of the Silicon Labs SiWx91x NWP
  (Network Wireless Coprocessor). They describe the NWP itself and are
  therefore independent of the way the host is connected to it.

include: base.yaml

properties:
  support-1p8v:
    type: boolean
    description: |
      Enables 1.8 V operation support.

  enable-xtal-correction:
    type: boolean
    description: |
      Enables automatic 40 MHz XTAL frequency correction.
      Disable this when using a custom or uncalibrated XTAL and manual tuning is required.

  qspi-80mhz-clk:
    type: boolean
    description: |
      Experimental feature.
      Enables 80 MHz QSPI clock mode for the NWP flash interface to improve
      throughput. Enable this if the external flash device supports 80 MHz
      operation; otherwise, keep it disabled.

  antenna-selection:
    type: string
    description: |
      Selects the front-end (antenna) switch configuration for the NWP.

      This property determines how the RF path is controlled:
        - "none": Reserved or unused configuration.
        - "ext-gpios": Use external ULP GPIOs (4, 5, and 0) as ANT_SEL control lines
          for the external RF switch network.
        - "internal": Use the internal on-chip RF switch logic. No external GPIO
          control is required. Recommended for boards without an external RF
          switch circuit.

      The value maps directly to bits [30:29] of the SL_SI91X_EXT_FEAT register:
        - 00b: Reserved
        - 01b: External GPIOs (ULP_GPIO4/5/0)
        - 10b: Internal front-end switch
        - 11b: Reserved
    enum:
      - "none"
      - "ext-gpios"
      - "internal"
    required: true

  # Note:
  # Zephyr typically manages clocks via a clock-controller driver.
  # However, the NWP is not yet fully compatible with that model.
  # This property is kept as a temporary solution for NWP-specific configuration.
  clock-frequency:
    type: int
    enum:
      - 80000000
      - 120000000
      - 160000000
    required: true
    description: |
      Clock frequency configuration for the NWP in Hz.
```

## dts/bindings/mfd/silabs,siwx91x-nwp-spi.yaml
```yaml
# Copyright (c) 2025 Silicon Laboratories Inc.
# SPDX-License-Identifier: Apache-2.0

title: Silicon Labs SiWx91x NWP connected over SPI

description: |
  The Network Wireless Processor (NWP) manages Wi-Fi and Bluetooth connectivity on SiWx91x devices,
  offloading wireless networking tasks from the main processor and
  supporting configurable power and performance modes.

  This binding covers the SiWN917 parts, where the NWP is a standalone chip
  driven by an arbitrary host over SPI.

  Example:

    &eusart1 {
            cs-gpios = <&gpioc 3 GPIO_ACTIVE_LOW>;

            nwp: siwx91x-nwp@0 {
                    compatible = "silabs,siwx91x-nwp-spi";
                    reg = <0>;
                    spi-max-frequency = <10000000>;
                    irq-gpios = <&gpioa 8 GPIO_ACTIVE_HIGH>;
                    antenna-selection = "internal";
                    clock-frequency = <80000000>;

                    wifi {
                            compatible = "silabs,siwx91x-wifi";
                    };
            };
    };

compatible: "silabs,siwx91x-nwp-spi"

include: ["silabs,siwx91x-nwp-common.yaml", spi-device.yaml]

properties:
  irq-gpios:
    type: phandle-array
    required: true
    description: |
      INT_OUT signal. The NWP asserts it when it has data or events pending for
      the host.

  reset-gpios:
    type: phandle-array
    description: |
      Optional RESET_N signal used to reset the NWP. If it is not provided,
      the driver does not reset the NWP.
```

## dts/bindings/mfd/silabs,siwx91x-nwp.yaml
```yaml
# Copyright (c) 2025 Silicon Laboratories Inc.
# SPDX-License-Identifier: Apache-2.0

title: Silicon Labs SiWx91x NWP (Network Wireless Coprocessor)

description: |
  The Network Wireless Processor (NWP) manages Wi-Fi and Bluetooth connectivity on SiWx91x devices,
  offloading wireless networking tasks from the main processor and
  supporting configurable power and performance modes.

  This binding covers the SiWG917 parts, where the NWP shares the die with the
  Cortex-M4 host and is reached through the internal AHB bus.

compatible: "silabs,siwx91x-nwp"

include: ["silabs,siwx91x-nwp-common.yaml", pinctrl-device.yaml]

properties:
  reg:
    required: true

  reg-names:
    required: true

  interrupts:
    required: true
```
